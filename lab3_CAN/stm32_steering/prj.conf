## CMakeLists.txt
```
cmake_minimum_required(VERSION 3.20.0)

include(${CMAKE_CURRENT_SOURCE_DIR}/../common/zephyr/lab3_common.cmake)
find_package(Zephyr REQUIRED HINTS $ENV{ZEPHYR_BASE})
project(stm32_steering)

lab3_add_common_libs()

# --- steering module (Lab 2 servo driver) ---
add_library(steering STATIC src/steering.c)
target_include_directories(steering PUBLIC ${CMAKE_CURRENT_SOURCE_DIR}/include)
target_link_libraries(steering PUBLIC zephyr_interface)
add_dependencies(steering zephyr_generated_headers)

# --- main app: STEER, FORCE_TX (RELAY is in common/zephyr/relay.c) ---
target_sources(app PRIVATE src/main.c)
target_include_directories(app PRIVATE ${CMAKE_CURRENT_SOURCE_DIR}/include)
target_link_libraries(app PRIVATE steering)
```

## prj.conf
```kconfig
CONFIG_GPIO=y
CONFIG_SPI=y
CONFIG_CAN=y
CONFIG_PWM=y
CONFIG_WATCHDOG=y

CONFIG_PRINTK=y
CONFIG_LOG=y

# Console shell, plus `can show can@0` / `can show can@1` for debugging
CONFIG_SHELL=y
CONFIG_CAN_SHELL=y

# Part 3 WCET measurement (common/zephyr/wcet.c): per-thread run time,
# peak run of the MCP2515 driver threads (found by name)
CONFIG_THREAD_RUNTIME_STATS=y
CONFIG_SCHED_THREAD_USAGE_ANALYSIS=y
CONFIG_THREAD_NAME=y
```

## src/main.c
```c
/*
 * N2 steering zone (front).
 *   STEER     on CTRL -> servo PWM (SRV). Keeps tracking in the system error
 *             state (R3); holds its position while N2 itself is LOCAL_FAIL
 *             (R4.7 "steering held"). Isolated, no CTRL arrives, so it holds.
 *   FORCE_TX  every 50 ms, dummy counter (handout: force feedback is a dummy)
 *   RELAY     common/zephyr/relay.c
 *   BLINK_F, HB_TX, HB_MON, TEST_BTN, error state: common/zephyr/zone_core.c
 */
#include <zephyr/kernel.h>
#include <zephyr/sys/printk.h>

#include "can_link.h"
#include "relay.h"
#include "steering.h"
#include "zone_config.h"
#include "wcet.h"
#include "zone_core.h"

/* Safe state = hold the current angle (R4.7), so nothing to do here */
static void steer_safe(void)
{
}

static void steer_thread(void *a, void *b, void *c)
{
	ARG_UNUSED(a); ARG_UNUSED(b); ARG_UNUSED(c);
	struct canp_ctrl cmd;

	while (1) {
		if (zone_wait_ctrl(&cmd, K_MSEC(ZONE_CTRL_TIMEOUT_MS)) != 0) {
			continue;   /* no CTRL: the servo holds where it is */
		}
		uint64_t w0 = wcet_begin();

		/* R3: track the wheel even in ERROR, unless N2 is the failed zone */
		if (zone_state() != CANP_ZS_LOCAL_FAIL) {
			(void)set_wheel_angle(cmd.steer);
		}
		wcet_end(WCET_ACT, w0);
	}
}

static void force_tx_thread(void *a, void *b, void *c)
{
	ARG_UNUSED(a); ARG_UNUSED(b); ARG_UNUSED(c);
	int64_t next = k_uptime_get();
	int8_t counter = 0;

	while (1) {
		next += CANP_FORCE_PERIOD_MS;
		k_sleep(K_TIMEOUT_ABS_MS(next));
		uint64_t w0 = wcet_begin();

		uint8_t d[CANP_DLC];

		canp_encode_force(d, 0, counter++);
		can_link_send(CANP_ID_FORCE, d);
		wcet_end(WCET_FORCE_TX, w0);
	}
}

K_THREAD_DEFINE(steer_tid, 1024, steer_thread, NULL, NULL, NULL,
		ZONE_PRIO_ACT, 0, SYS_FOREVER_MS);
K_THREAD_DEFINE(force_tid, 1024, force_tx_thread, NULL, NULL, NULL,
		ZONE_PRIO_FORCE_TX, 0, SYS_FOREVER_MS);

static const struct zone_config n2_cfg = {
	.zone = CANP_ZONE_N2,
	.enter_safe = steer_safe,
	.rx_hook = relay_rx_hook,
};

int main(void)
{
	printk("\n=== Lab 3 N2 steering zone ===\n");

	if (servo_init() != 0) {
		printk("N2: servo PWM not ready\n");
	}
	relay_init(CANP_ZONE_N2);
	zone_core_init(&n2_cfg);
	k_thread_start(steer_tid);
	k_thread_start(force_tid);

	/* Status printing is background work: below every real-time task */
	k_thread_priority_set(k_current_get(), ZONE_PRIO_STATUS);

	for (uint32_t tick = 1;; tick++) {
		k_msleep(ZONE_STATUS_PERIOD_MS);
		uint64_t w0 = wcet_begin();

		zone_print_status();
		if (tick % 5 == 0) {
			wcet_print();
		}

		uint32_t relayed, overflow;

		relay_get_stats(&relayed, &overflow);
		printk("   relay: %u forwarded, %u dropped (queue full)\n", relayed, overflow);
		wcet_end(WCET_STATUS, w0);
	}
	return 0;
}
```

## include/relay.h
```c
#ifndef RELAY_H
#define RELAY_H

#include <stdint.h>

#include "can_proto.h"

/* zone_config.rx_hook for N2: queues frames for the RELAY thread */
void relay_rx_hook(uint32_t id, const uint8_t data[CANP_DLC], enum canp_bus bus);

void relay_get_stats(uint32_t *n_relayed, uint32_t *n_overflow);

#endif /* RELAY_H */
```

## src/motor_control.c
```c
#include <errno.h>

#include <zephyr/device.h>
#include <zephyr/drivers/gpio.h>
#include <zephyr/drivers/pwm.h>
#include <zephyr/kernel.h>
#include <zephyr/sys/printk.h>
#include <zephyr/sys/atomic.h>

#include "motor_control.h"
#include "testpoints.h"

/*
 * Device-tree aliases make this file read like the wiring diagram rather
 * than scattering port/pin numbers through the control code.
 */
static const struct pwm_dt_spec motor_left_pwm =
	PWM_DT_SPEC_GET(DT_ALIAS(motor_left_pwm));
static const struct pwm_dt_spec motor_right_pwm =
	PWM_DT_SPEC_GET(DT_ALIAS(motor_right_pwm));

static const struct gpio_dt_spec motor_left_in1 =
	GPIO_DT_SPEC_GET(DT_ALIAS(motor_left_in1), gpios);
static const struct gpio_dt_spec motor_left_in2 =
	GPIO_DT_SPEC_GET(DT_ALIAS(motor_left_in2), gpios);
static const struct gpio_dt_spec motor_right_in3 =
	GPIO_DT_SPEC_GET(DT_ALIAS(motor_right_in3), gpios);
static const struct gpio_dt_spec motor_right_in4 =
	GPIO_DT_SPEC_GET(DT_ALIAS(motor_right_in4), gpios);

static const struct gpio_dt_spec *const direction_pins[] = {
	&motor_left_in1,
	&motor_left_in2,
	&motor_right_in3,
	&motor_right_in4,
};

static atomic_t manual_test_active = ATOMIC_INIT(0);

static int first_error(int previous, int candidate)
{
	return previous != 0 ? previous : candidate;
}

static int set_directions(const struct gpio_dt_spec *first,
			  const struct gpio_dt_spec *second, int first_value,
			  int second_value)
{
	int rc = gpio_pin_set_dt(first, first_value);

	return first_error(rc, gpio_pin_set_dt(second, second_value));
}

static int set_pwm_percent(const struct pwm_dt_spec *pwm, unsigned int duty_percent)
{
	if (duty_percent > 100U) {
		return -EINVAL;
	}

	return pwm_set_dt(pwm, pwm->period,
			  (pwm->period * duty_percent) / 100U);
}

int motor_control_safe_stop(void)
{
	int rc = 0;

	/* Disable the two L298N channels before changing either direction pair. */
	rc = first_error(rc, pwm_set_dt(&motor_left_pwm, motor_left_pwm.period, 0));
	rc = first_error(rc, pwm_set_dt(&motor_right_pwm, motor_right_pwm.period, 0));

	/* Both inputs low with enable low is a non-driving/coast state. */
	for (size_t i = 0; i < ARRAY_SIZE(direction_pins); ++i) {
		rc = first_error(rc, gpio_pin_set_dt(direction_pins[i], 0));
	}

	return rc;
}

int motor_control_set_state(enum motor_control_channel channel,
			    enum motor_control_state state, unsigned int duty_percent)
{
	const struct pwm_dt_spec *pwm;
	const struct gpio_dt_spec *first;
	const struct gpio_dt_spec *second;
	int forward_first;
	int forward_second;
	int rc;

	if (channel == MOTOR_CHANNEL_A) {
		pwm = &motor_left_pwm;
		first = &motor_left_in1;
		second = &motor_left_in2;
		/* Left wheel: OUT1/OUT2 polarity that moves the vehicle forward. */
		forward_first = 0;
		forward_second = 1;
	} else if (channel == MOTOR_CHANNEL_B) {
		pwm = &motor_right_pwm;
		first = &motor_right_in3;
		second = &motor_right_in4;
		/* Right wheel: OUT3/OUT4 polarity that moves the vehicle forward. */
		forward_first = 1;
		forward_second = 0;
	} else {
		return -EINVAL;
	}

	if (state != MOTOR_CONTROL_BRAKE && duty_percent > 100U) {
		return -EINVAL;
	}

	/* Never change H-bridge direction while its PWM enable is asserted. */
	rc = set_pwm_percent(pwm, 0U);
	if (rc != 0) {
		return rc;
	}

	switch (state) {
	case MOTOR_CONTROL_COAST:
		return set_directions(first, second, 0, 0);
	case MOTOR_CONTROL_FORWARD:
		rc = set_directions(first, second, forward_first, forward_second);
		break;
	case MOTOR_CONTROL_REVERSE:
		rc = set_directions(first, second, !forward_first, !forward_second);
		break;
	case MOTOR_CONTROL_BRAKE:
		/* L298N fast stop: short both motor terminals high while enabled. */
		rc = set_directions(first, second, 1, 1);
		duty_percent = 100U;
		break;
	default:
		return -EINVAL;
	}

	if (rc != 0) {
		return rc;
	}
	rc = set_pwm_percent(pwm, duty_percent);
	testpoint_set(TP_PWM_SET, true);
	k_busy_wait(100);
	testpoint_set(TP_PWM_SET, false);
	return rc;
}

int motor_control_drive_forward(unsigned int duty_percent)
{
	int rc = motor_control_set_state(MOTOR_CHANNEL_A, MOTOR_CONTROL_FORWARD,
					 duty_percent);

	return first_error(rc, motor_control_set_state(MOTOR_CHANNEL_B,
						      MOTOR_CONTROL_FORWARD,
						      duty_percent));
}

int motor_control_dynamic_brake(void)
{
	int rc = motor_control_set_state(MOTOR_CHANNEL_A, MOTOR_CONTROL_BRAKE, 0U);

	return first_error(rc, motor_control_set_state(MOTOR_CHANNEL_B,
						      MOTOR_CONTROL_BRAKE, 0U));
}

int motor_control_init(void)
{
	int rc;

	if (!pwm_is_ready_dt(&motor_left_pwm) || !pwm_is_ready_dt(&motor_right_pwm)) {
		printk("Motor PWM device is not ready\n");
		return -ENODEV;
	}

	/* Keep both channels disabled while the direction pins are configured. */
	rc = set_pwm_percent(&motor_left_pwm, 0U);
	if (rc != 0) {
		return rc;
	}
	rc = set_pwm_percent(&motor_right_pwm, 0U);
	if (rc != 0) {
		return rc;
	}

	for (size_t i = 0; i < ARRAY_SIZE(direction_pins); ++i) {
		if (!gpio_is_ready_dt(direction_pins[i])) {
			printk("Motor direction GPIO is not ready\n");
			return -ENODEV;
		}

		rc = gpio_pin_configure_dt(direction_pins[i], GPIO_OUTPUT_ACTIVE);
		if (rc != 0) {
			return rc;
		}
	}

	/* Hold both wheels when the application starts without a Pi command. */
	rc = motor_control_dynamic_brake();
	if (rc == 0) {
		printk("Motor outputs initialized braked: PWM=100%%, IN1..IN4=1\n");
	}

	return rc;
}

bool motor_control_manual_test_active(void)
{
	return atomic_get(&manual_test_active) != 0;
}

int motor_control_pulse(enum motor_control_channel channel)
{
	int rc;

	if (channel != MOTOR_CHANNEL_A && channel != MOTOR_CHANNEL_B) {
		return -EINVAL;
	}

	/* A second shell request cannot overlap an active timed pulse. */
	if (!atomic_cas(&manual_test_active, 0, 1)) {
		return -EBUSY;
	}

	/* Begin from a known non-driving state before selecting a direction. */
	rc = motor_control_safe_stop();
	if (rc != 0) {
		goto done;
	}

	rc = motor_control_set_state(channel, MOTOR_CONTROL_FORWARD,
				     MOTOR_TEST_DUTY_PERCENT);
	if (rc == 0) {
		k_sleep(K_MSEC(MOTOR_TEST_DURATION_MS));
	}

	/* Restore the held-wheel idle state after the timed pulse. */
	rc = first_error(rc, motor_control_dynamic_brake());

done:
	atomic_set(&manual_test_active, 0);
	return rc;
}
```

## src/pid_controller.c
```c
#include "pid_controller.h"

static float clamp(float value, float minimum, float maximum)
{
	if (value < minimum) {
		return minimum;
	}
	if (value > maximum) {
		return maximum;
	}
	return value;
}

void pid_controller_init(struct pid_controller *controller, float kp, float ki,
			 float kd, float output_min, float output_max)
{
	controller->kp = kp;
	controller->ki = ki;
	controller->kd = kd;
	controller->output_min = output_min;
	controller->output_max = output_max;
	pid_controller_reset(controller);
}

void pid_controller_reset(struct pid_controller *controller)
{
	controller->integral = 0.0f;
	controller->previous_error = 0.0f;
	controller->have_previous_error = false;
}

void pid_controller_set_gains(struct pid_controller *controller, float kp,
			      float ki, float kd)
{
	controller->kp = kp;
	controller->ki = ki;
	controller->kd = kd;
}

float pid_controller_update(struct pid_controller *controller, float setpoint,
			    float measurement, float dt_seconds)
{
	float error = setpoint - measurement;
	float derivative = 0.0f;
	float candidate_integral;
	float output;

	if (dt_seconds <= 0.0f) {
		return clamp(controller->kp * error, controller->output_min,
			     controller->output_max);
	}

	candidate_integral = controller->integral + error * dt_seconds;
	if (controller->have_previous_error) {
		derivative = (error - controller->previous_error) / dt_seconds;
	}

	output = controller->kp * error + controller->ki * candidate_integral +
		 controller->kd * derivative;

	/* Integrate only when the output is not driving farther into saturation. */
	if ((output <= controller->output_max || error < 0.0f) &&
	    (output >= controller->output_min || error > 0.0f)) {
		controller->integral = candidate_integral;
	}

	controller->previous_error = error;
	controller->have_previous_error = true;
	return clamp(output, controller->output_min, controller->output_max);
}
```

## src/relay.c
```c
/*
 * RELAY (N2 only): N2 is the middle node, on both buses, so it forwards
 * traffic between them for R4.8 scenario (c) (N1 only on A, N3 only on B).
 *
 * Design: always relay, no fault detection needed, so the first relayed
 * frame isn't delayed by the 60 ms degraded-bus detection. Cost: N1's and
 * N3's frames appear twice on each bus (receivers drop the copy by seq).
 *
 * What gets relayed: every accepted (first-copy) frame that N2 didn't send
 * itself, onto the OTHER bus from the one it arrived on, with
 * CANP_FLAG_RELAYED set. CTRL's CRC masks the flags nibble, so it stays
 * valid. No loops: only N2 relays, and it never re-relays a flagged frame.
 */
#include <string.h>

#include <zephyr/drivers/gpio.h>
#include <zephyr/kernel.h>

#include "can_link.h"
#include "relay.h"
#include "wcet.h"
#include "zone_config.h"

struct relay_item {
	uint32_t id;
	uint8_t data[CANP_DLC];
	uint8_t from_bus;
};

#define RELAY_TP_MIN_US 10

/* Depth covers one 20 ms cycle of N1 + N3 traffic with room to spare */
K_MSGQ_DEFINE(relay_q, sizeof(struct relay_item), 16, 4);

static const struct gpio_dt_spec tp_relay_tx = GPIO_DT_SPEC_GET(DT_ALIAS(tp_relay_tx), gpios);
static atomic_t relayed, overflow;

static bool should_relay(uint32_t id, const uint8_t *data)
{
	if (canp_flags(data) & CANP_FLAG_RELAYED) {
		return false;
	}
	switch (id) {
	case CANP_ID_CTRL:
	case CANP_ID_BLINK:
	case CANP_ID_HB_N1:
	case CANP_ID_HB_N3:
		return true;
	case CANP_ID_FAULT:
		return canp_fault_zone(data) != CANP_ZONE_N2;
	default:
		return false;   /* FORCE and HB_N2 are N2's own */
	}
}

/* MCP2515 RX thread context: copy and hand off, never block */
void relay_rx_hook(uint32_t id, const uint8_t data[CANP_DLC], enum canp_bus bus)
{
	if (!should_relay(id, data)) {
		return;
	}
	struct relay_item item = { .id = id, .from_bus = bus };

	memcpy(item.data, data, CANP_DLC);
	if (k_msgq_put(&relay_q, &item, K_NO_WAIT) != 0) {
		atomic_inc(&overflow);
	}
}

static void relay_thread(void *a, void *b, void *c)
{
	ARG_UNUSED(a); ARG_UNUSED(b); ARG_UNUSED(c);
	struct relay_item item;

	gpio_pin_configure_dt(&tp_relay_tx, GPIO_OUTPUT_INACTIVE);

	while (1) {
		k_msgq_get(&relay_q, &item, K_FOREVER);
		uint64_t w0 = wcet_begin();

		enum canp_bus to = (item.from_bus == CANP_BUS_A) ? CANP_BUS_B : CANP_BUS_A;

		item.data[0] |= CANP_FLAG_RELAYED;

		/* RELAY_TX test point: rising edge = forwarded frame queued. Held
		 * >= RELAY_TP_MIN_US: queuing alone takes ~1 us, too narrow for
		 * the scope at the 100 us/div needed to see UDP_RX too. */
		uint32_t start = k_cycle_get_32();

		gpio_pin_set_dt(&tp_relay_tx, 1);
		if (can_link_send_on(to, item.id, item.data) == 0) {
			atomic_inc(&relayed);
		}
		uint32_t elapsed_us = k_cyc_to_us_floor32(k_cycle_get_32() - start);

		if (elapsed_us < RELAY_TP_MIN_US) {
			k_busy_wait(RELAY_TP_MIN_US - elapsed_us);
		}
		gpio_pin_set_dt(&tp_relay_tx, 0);
		wcet_end(WCET_RELAY, w0);   /* includes the >=10 us test-point hold */
	}
}

K_THREAD_DEFINE(relay_tid, 1024, relay_thread, NULL, NULL, NULL, ZONE_PRIO_RELAY, 0, 0);

void relay_get_stats(uint32_t *n_relayed, uint32_t *n_overflow)
{
	*n_relayed = atomic_get(&relayed);
	*n_overflow = atomic_get(&overflow);
}
```
