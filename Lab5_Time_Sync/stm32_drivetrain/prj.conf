## CMakeLists.txt
```
cmake_minimum_required(VERSION 3.20.0)

include(${CMAKE_CURRENT_SOURCE_DIR}/../common/zephyr/lab5_common.cmake)
find_package(Zephyr REQUIRED HINTS $ENV{ZEPHYR_BASE})
project(stm32_drivetrain)

lab5_add_common_libs()
lab5_add_zone_libs()

# --- Lab 2 drivetrain modules, one library each (see CLAUDE.md conventions) ---
foreach(mod testpoints motor_control encoder pid_controller)
  add_library(${mod} STATIC src/${mod}.c)
  target_include_directories(${mod} PUBLIC ${CMAKE_CURRENT_SOURCE_DIR}/include)
  target_link_libraries(${mod} PUBLIC zephyr_interface)
  add_dependencies(${mod} zephyr_generated_headers)
  target_link_libraries(app PRIVATE ${mod})
endforeach()
target_link_libraries(motor_control PUBLIC testpoints)

# --- main app: DRIVE, PID ---
target_sources(app PRIVATE src/main.c)
target_include_directories(app PRIVATE ${CMAKE_CURRENT_SOURCE_DIR}/include)
```

## Kconfig
```
rsource "../common/zephyr/Kconfig.lab5"

source "Kconfig.zephyr"
```

## prj.conf
```kconfig
CONFIG_GPIO=y
CONFIG_SPI=y
CONFIG_CAN=y
CONFIG_PWM=y
CONFIG_WATCHDOG=y

CONFIG_PRINTK=y
CONFIG_LOG=y

# Console shell, plus `can show can@0` / `can show can@1` for debugging
CONFIG_SHELL=y
CONFIG_CAN_SHELL=y

# Part 3 WCET measurement (common/zephyr/wcet.c): per-thread run time,
# peak run of the MCP2515 driver threads (found by name)
CONFIG_THREAD_RUNTIME_STATS=y
CONFIG_SCHED_THREAD_USAGE_ANALYSIS=y
CONFIG_THREAD_NAME=y

# Lab 5: Raft debug lines at boot overflowed the default 1 KB log buffer
CONFIG_LOG_BUFFER_SIZE=8192
```

## src/main.c
```c
/*
 * N3 drivetrain zone (rear). Lab 5 copy of lab3_CAN/stm32_drivetrain, plus
 * the Raft node, time sync and routed relay (common/zephyr/raft_node.c).
 *   DRIVE  on CTRL: brake -> dynamic brake now (DIR_A = IN4); throttle ->
 *          feed-forward duty written now (PWM_SET), so R2.1/R2.2 don't wait
 *          for the PID period.
 *   PID    10 ms timer: per-wheel speed correction added on top of the
 *          feed-forward duty, with real elapsed dt (Lab 2 lesson).
 *   RELAY  common/zephyr/relay.c (checkoff: N1 off A + N2 off B, and the reverse)
 *   BLINK_R, HB_TX, HB_MON, TEST_BTN, error state: common/zephyr/zone_core.c
 *
 * Every motor command goes through motor_lock: DRIVE, PID and the safe-state
 * hook all touch the H-bridge, and motor_control_set_state() must not be
 * interleaved (it disables PWM before changing direction).
 */
#include <zephyr/kernel.h>
#include <zephyr/sys/printk.h>

#include "can_link.h"
#include "encoder.h"
#include "motor_control.h"
#include "pid_controller.h"
#include "raft_node.h"
#include "relay.h"
#include "testpoints.h"
#include "zone_config.h"
#include "wcet.h"
#include "zone_core.h"

#define PID_PERIOD_MS            10
#define BRAKE_ACTIVE_PCT         5     /* Lab 2: 50/1000 */
#define MOTOR_MIN_EFFECTIVE_DUTY 55U   /* measured breakaway duty (Lab 2) */
#define PID_TRIM_LIMIT           40.0f /* PID adds -40..+40 % to feed-forward */

/* Lab 2 measured values. Gains need re-tuning: PID is now a trim, 10 ms */
#define PID_MAX_SPEED            6500.0f   /* encoder transitions/s at 100 % */
#define PID_KP                   0.15f
#define PID_KI                   0.04f
#define PID_KD                   0.0f
#define RIGHT_ENCODER_SIGN       1
#define LEFT_ENCODER_SIGN        (-1)

static K_MUTEX_DEFINE(motor_lock);

/* Protected by motor_lock */
static bool driving;
static uint8_t target_throttle;          /* 0..100 % */
static float trim_left, trim_right;
static unsigned int duty_left, duty_right;
static struct pid_controller pid_left, pid_right;
static int32_t prev_right_count, prev_left_count;
static int64_t prev_pid_ms;
static bool have_sample;

static unsigned int feed_forward(uint8_t throttle)
{
	if (throttle == 0) {
		return 0;
	}
	return MOTOR_MIN_EFFECTIVE_DUTY +
	       ((100U - MOTOR_MIN_EFFECTIVE_DUTY) * throttle) / 100U;
}

static unsigned int clamp_duty(float d)
{
	if (d < (float)MOTOR_MIN_EFFECTIVE_DUTY) {
		return MOTOR_MIN_EFFECTIVE_DUTY;
	}
	return d > 100.0f ? 100U : (unsigned int)d;
}

/* Caller holds motor_lock */
static void reset_drive_locked(void)
{
	driving = false;
	target_throttle = 0;
	trim_left = trim_right = 0.0f;
	pid_controller_reset(&pid_left);
	pid_controller_reset(&pid_right);
	have_sample = false;
}

/* Caller holds motor_lock. Cache braking separately from neutral/coasting. */
static void brake_locked(void)
{
	(void)motor_control_dynamic_brake();
	reset_drive_locked();
	duty_left = duty_right = 100U;
}

static void coast_locked(void)
{
	(void)motor_control_safe_stop();
	reset_drive_locked();
	duty_left = duty_right = 0U;
}

/* Caller holds motor_lock. Only rewrite a channel whose duty changed, so the
 * H-bridge isn't glitched to 0 % every 20 ms. */
static void apply_duty_locked(unsigned int left, unsigned int right, bool force)
{
	if (force || left != duty_left) {
		(void)motor_control_set_state(MOTOR_CHANNEL_A, MOTOR_CONTROL_FORWARD, left);
		duty_left = left;
	}
	if (force || right != duty_right) {
		(void)motor_control_set_state(MOTOR_CHANNEL_B, MOTOR_CONTROL_FORWARD, right);
		duty_right = right;
	}
}

static void drive_safe(void)
{
	k_mutex_lock(&motor_lock, K_FOREVER);
	brake_locked();
	k_mutex_unlock(&motor_lock);
}

static void drive_thread(void *a, void *b, void *c)
{
	ARG_UNUSED(a); ARG_UNUSED(b); ARG_UNUSED(c);
	struct canp_ctrl cmd;

	while (1) {
		if (zone_wait_ctrl(&cmd, K_MSEC(ZONE_CTRL_TIMEOUT_MS)) != 0) {
			continue;   /* HB_MON moves us to ERROR and brakes via drive_safe */
		}
		uint64_t w0 = wcet_begin();

		k_mutex_lock(&motor_lock, K_FOREVER);
		if (zone_state() != CANP_ZS_NORMAL || cmd.brake >= BRAKE_ACTIVE_PCT) {
			if (driving || duty_left != 100U) {
				brake_locked();
			}
		} else if (cmd.throttle == 0) {
			if (driving || duty_left != 0U || duty_right != 0U) {
				coast_locked();
			}
		} else {
			bool start = !driving;
			unsigned int ff = feed_forward(cmd.throttle);

			target_throttle = cmd.throttle;
			driving = true;
			apply_duty_locked(clamp_duty(ff + trim_left), clamp_duty(ff + trim_right), start);
		}
		k_mutex_unlock(&motor_lock);
		wcet_end(WCET_ACT, w0);
	}
}

static void pid_thread(void *a, void *b, void *c)
{
	ARG_UNUSED(a); ARG_UNUSED(b); ARG_UNUSED(c);
	int64_t next = k_uptime_get();

	while (1) {
		next += PID_PERIOD_MS;
		k_sleep(K_TIMEOUT_ABS_MS(next));
		uint64_t w0 = wcet_begin();

		k_mutex_lock(&motor_lock, K_FOREVER);
		if (!driving) {
			k_mutex_unlock(&motor_lock);
			wcet_end(WCET_PID, w0);
			continue;
		}

		int64_t now = k_uptime_get();
		int32_t right_count, left_count;

		encoder_get_counts(&right_count, &left_count);
		if (have_sample) {
			/* Real elapsed dt, never the nominal period */
			float dt = (float)(now - prev_pid_ms) / 1000.0f;
			float target = (target_throttle / 100.0f) * PID_MAX_SPEED;
			float right_speed = RIGHT_ENCODER_SIGN * (right_count - prev_right_count) / dt;
			float left_speed = LEFT_ENCODER_SIGN * (left_count - prev_left_count) / dt;
			unsigned int ff = feed_forward(target_throttle);

			trim_right = pid_controller_update(&pid_right, target, right_speed, dt);
			trim_left = pid_controller_update(&pid_left, target, left_speed, dt);
			apply_duty_locked(clamp_duty(ff + trim_left), clamp_duty(ff + trim_right), false);
		}
		prev_right_count = right_count;
		prev_left_count = left_count;
		prev_pid_ms = now;
		have_sample = true;
		k_mutex_unlock(&motor_lock);
		wcet_end(WCET_PID, w0);
	}
}

K_THREAD_DEFINE(drive_tid, 1024, drive_thread, NULL, NULL, NULL,
		ZONE_PRIO_ACT, 0, SYS_FOREVER_MS);
K_THREAD_DEFINE(pid_tid, 1024, pid_thread, NULL, NULL, NULL,
		ZONE_PRIO_PID, 0, SYS_FOREVER_MS);

static const struct zone_config n3_cfg = {
	.zone = CANP_ZONE_N3,
	.enter_safe = drive_safe,
	.rx_hook = relay_rx_hook,
};

int main(void)
{
	printk("\n=== Lab 5 N3 drivetrain zone ===\n");

	if (testpoints_init() != 0) {
		printk("N3: test points not ready\n");
	}
	pid_controller_init(&pid_left, PID_KP, PID_KI, PID_KD, -PID_TRIM_LIMIT, PID_TRIM_LIMIT);
	pid_controller_init(&pid_right, PID_KP, PID_KI, PID_KD, -PID_TRIM_LIMIT, PID_TRIM_LIMIT);
	if (motor_control_init() != 0) {
		printk("N3: motor outputs not ready\n");
	}
	if (encoder_init() != 0) {
		printk("N3: encoders not ready\n");
	}

	relay_init(CANP_ZONE_N3);
	zone_core_init(&n3_cfg);   /* calls drive_safe: start braked */
	raft_node_init(CANP_ZONE_N3);   /* Raft, time sync, routing */
	k_thread_start(drive_tid);
	k_thread_start(pid_tid);

	/* Status printing is background work: below every real-time task */
	k_thread_priority_set(k_current_get(), ZONE_PRIO_STATUS);

	for (uint32_t tick = 1;; tick++) {
		k_msleep(ZONE_STATUS_PERIOD_MS);
		uint64_t w0 = wcet_begin();

		zone_print_status();
		raft_node_print_status();
		if (tick % 5 == 0) {
			wcet_print();
		}

		/* Copy under the lock, print outside it: DRIVE must not wait
		 * behind this (lowest-priority) thread's printk */
		k_mutex_lock(&motor_lock, K_FOREVER);
		bool drv = driving;
		unsigned int thr = target_throttle, dl = duty_left, dr = duty_right;

		k_mutex_unlock(&motor_lock);
		printk("   drive: %s thr %u%% duty L%u R%u\n", drv ? "DRIVE" : "BRAKE", thr, dl, dr);

		uint32_t relayed, overflow;

		relay_get_stats(&relayed, &overflow);
		printk("   relay: %u forwarded, %u dropped (queue full)\n", relayed, overflow);
		wcet_end(WCET_STATUS, w0);
	}
	return 0;
}
```

## include/motor_control.h
```c
#ifndef MOTOR_CONTROL_H
#define MOTOR_CONTROL_H

#include <stdbool.h>

#define MOTOR_TEST_DURATION_MS  2000U
#define MOTOR_TEST_DUTY_PERCENT 75U

/*
 * Low-level interface to the L298N. Initialization applies dynamic braking
 * (both PWM enables at 100% and all four direction inputs high); subsequent
 * commands change direction only after first disabling the PWM enable.
 */

int motor_control_init(void);
int motor_control_safe_stop(void);

enum motor_control_channel {
	MOTOR_CHANNEL_A, /* Left: L298N OUT1 / OUT2, controlled by ENA / IN1 / IN2 */
	MOTOR_CHANNEL_B, /* Right: L298N OUT3 / OUT4, controlled by ENB / IN3 / IN4 */
};

enum motor_control_state {
	MOTOR_CONTROL_COAST,
	MOTOR_CONTROL_FORWARD,
	MOTOR_CONTROL_REVERSE,
	MOTOR_CONTROL_BRAKE,
};

/* Set one H-bridge channel. Duty is a percent (0 through 100). */
int motor_control_set_state(enum motor_control_channel channel,
			    enum motor_control_state state, unsigned int duty_percent);

/* Apply the same forward duty to both physical wheels. */
int motor_control_drive_forward(unsigned int duty_percent);
int motor_control_dynamic_brake(void);

/*
 * Bench-only proof of the wired output path. This drives exactly one channel
 * at the configured test duty/duration, then returns to dynamic braking.
 */
int motor_control_pulse(enum motor_control_channel channel);
bool motor_control_manual_test_active(void);

#endif /* MOTOR_CONTROL_H */
```

## src/encoder.c
```c
#include <errno.h>
#include <stdint.h>

#include <zephyr/device.h>
#include <zephyr/drivers/gpio.h>
#include <zephyr/sys/atomic.h>
#include <zephyr/sys/printk.h>
#include <zephyr/sys/util.h>

#include "encoder.h"

/*
 * Each encoder is decoded at x4: an interrupt on either A or B phase reads
 * both phases and advances the signed transition count.  The sign is a
 * wiring convention; reversing a wheel reverses its sign, which we will
 * normalize when the speed controller is added.
 */
struct quadrature_encoder {
	const char *name;
	struct gpio_dt_spec phase_a;
	struct gpio_dt_spec phase_b;
	struct gpio_callback phase_a_callback;
	struct gpio_callback phase_b_callback;
	atomic_t count;
	atomic_t phase_a_edges;
	atomic_t phase_b_edges;
	uint8_t previous_state;
};

static struct quadrature_encoder right_encoder = {
	.name = "right",
	.phase_a = GPIO_DT_SPEC_GET(DT_ALIAS(encoder_right_a), gpios),
	.phase_b = GPIO_DT_SPEC_GET(DT_ALIAS(encoder_right_b), gpios),
};

static struct quadrature_encoder left_encoder = {
	.name = "left",
	.phase_a = GPIO_DT_SPEC_GET(DT_ALIAS(encoder_left_a), gpios),
	.phase_b = GPIO_DT_SPEC_GET(DT_ALIAS(encoder_left_b), gpios),
};

/* Valid Gray-code transitions in the order 00 -> 01 -> 11 -> 10 -> 00. */
static const int8_t quadrature_delta[16] = {
	[0x1] = 1,  [0x4] = -1,
	[0x2] = -1, [0x7] = 1,
	[0x8] = 1,  [0xB] = -1,
	[0xD] = -1, [0xE] = 1,
};

static int read_state(const struct quadrature_encoder *encoder, uint8_t *state)
{
	int a = gpio_pin_get_dt(&encoder->phase_a);
	int b = gpio_pin_get_dt(&encoder->phase_b);

	if (a < 0) {
		return a;
	}
	if (b < 0) {
		return b;
	}

	*state = ((uint8_t)(a != 0) << 1) | (uint8_t)(b != 0);
	return 0;
}

static void count_transition(struct quadrature_encoder *encoder)
{
	uint8_t state;

	/* Interrupt context: keep this bounded; never print or calculate speed. */
	if (read_state(encoder, &state) == 0) {
		atomic_add(&encoder->count,
			   quadrature_delta[(encoder->previous_state << 2) | state]);
		encoder->previous_state = state;
	}
}

static void phase_a_callback(const struct device *port,
			     struct gpio_callback *callback, gpio_port_pins_t pins)
{
	ARG_UNUSED(port);
	ARG_UNUSED(pins);
	struct quadrature_encoder *encoder = CONTAINER_OF(
		callback, struct quadrature_encoder, phase_a_callback);

	atomic_inc(&encoder->phase_a_edges);
	count_transition(encoder);
}

static void phase_b_callback(const struct device *port,
			     struct gpio_callback *callback, gpio_port_pins_t pins)
{
	ARG_UNUSED(port);
	ARG_UNUSED(pins);
	struct quadrature_encoder *encoder = CONTAINER_OF(
		callback, struct quadrature_encoder, phase_b_callback);

	atomic_inc(&encoder->phase_b_edges);
	count_transition(encoder);
}

static int configure_encoder(struct quadrature_encoder *encoder)
{
	uint8_t state;
	int rc;

	if (!gpio_is_ready_dt(&encoder->phase_a) ||
	    !gpio_is_ready_dt(&encoder->phase_b)) {
		printk("%s encoder GPIO is not ready\n", encoder->name);
		return -ENODEV;
	}

	/* The internal pull-ups provide an idle level for open-drain encoders. */
	rc = gpio_pin_configure_dt(&encoder->phase_a, GPIO_INPUT | GPIO_PULL_UP);
	if (rc != 0) {
		return rc;
	}
	rc = gpio_pin_configure_dt(&encoder->phase_b, GPIO_INPUT | GPIO_PULL_UP);
	if (rc != 0) {
		return rc;
	}

	rc = read_state(encoder, &state);
	if (rc != 0) {
		return rc;
	}
	encoder->previous_state = state;
	atomic_set(&encoder->count, 0);
	atomic_set(&encoder->phase_a_edges, 0);
	atomic_set(&encoder->phase_b_edges, 0);

	gpio_init_callback(&encoder->phase_a_callback, phase_a_callback,
			   BIT(encoder->phase_a.pin));
	gpio_init_callback(&encoder->phase_b_callback, phase_b_callback,
			   BIT(encoder->phase_b.pin));

	rc = gpio_add_callback(encoder->phase_a.port, &encoder->phase_a_callback);
	if (rc != 0) {
		return rc;
	}
	rc = gpio_add_callback(encoder->phase_b.port, &encoder->phase_b_callback);
	if (rc != 0) {
		return rc;
	}

	rc = gpio_pin_interrupt_configure_dt(&encoder->phase_a, GPIO_INT_EDGE_BOTH);
	if (rc != 0) {
		return rc;
	}
	return gpio_pin_interrupt_configure_dt(&encoder->phase_b, GPIO_INT_EDGE_BOTH);
}

int encoder_init(void)
{
	int rc = configure_encoder(&right_encoder);

	if (rc != 0) {
		return rc;
	}
	rc = configure_encoder(&left_encoder);
	if (rc == 0) {
		printk("Encoders ready: right D7/D8, left D5/D6\n");
	}
	return rc;
}

void encoder_get_counts(int32_t *right_count, int32_t *left_count)
{
	if (right_count != NULL) {
		*right_count = (int32_t)atomic_get(&right_encoder.count);
	}
	if (left_count != NULL) {
		*left_count = (int32_t)atomic_get(&left_encoder.count);
	}
}

void encoder_zero_counts(void)
{
	atomic_set(&right_encoder.count, 0);
	atomic_set(&left_encoder.count, 0);
	atomic_set(&right_encoder.phase_a_edges, 0);
	atomic_set(&right_encoder.phase_b_edges, 0);
	atomic_set(&left_encoder.phase_a_edges, 0);
	atomic_set(&left_encoder.phase_b_edges, 0);
}

void encoder_get_edge_counts(int32_t *right_a, int32_t *right_b,
			     int32_t *left_a, int32_t *left_b)
{
	if (right_a != NULL) {
		*right_a = (int32_t)atomic_get(&right_encoder.phase_a_edges);
	}
	if (right_b != NULL) {
		*right_b = (int32_t)atomic_get(&right_encoder.phase_b_edges);
	}
	if (left_a != NULL) {
		*left_a = (int32_t)atomic_get(&left_encoder.phase_a_edges);
	}
	if (left_b != NULL) {
		*left_b = (int32_t)atomic_get(&left_encoder.phase_b_edges);
	}
}

int encoder_get_levels(uint8_t *right_a, uint8_t *right_b,
		       uint8_t *left_a, uint8_t *left_b)
{
	uint8_t right_state;
	uint8_t left_state;
	int rc = read_state(&right_encoder, &right_state);

	if (rc != 0) {
		return rc;
	}
	rc = read_state(&left_encoder, &left_state);
	if (rc != 0) {
		return rc;
	}

	*right_a = (right_state >> 1) & 1U;
	*right_b = right_state & 1U;
	*left_a = (left_state >> 1) & 1U;
	*left_b = left_state & 1U;
	return 0;
}
```

## src/motor_control.c
```c
#include <errno.h>

#include <zephyr/device.h>
#include <zephyr/drivers/gpio.h>
#include <zephyr/drivers/pwm.h>
#include <zephyr/kernel.h>
#include <zephyr/sys/printk.h>
#include <zephyr/sys/atomic.h>

#include "motor_control.h"
#include "testpoints.h"

/*
 * Device-tree aliases make this file read like the wiring diagram rather
 * than scattering port/pin numbers through the control code.
 */
static const struct pwm_dt_spec motor_left_pwm =
	PWM_DT_SPEC_GET(DT_ALIAS(motor_left_pwm));
static const struct pwm_dt_spec motor_right_pwm =
	PWM_DT_SPEC_GET(DT_ALIAS(motor_right_pwm));

static const struct gpio_dt_spec motor_left_in1 =
	GPIO_DT_SPEC_GET(DT_ALIAS(motor_left_in1), gpios);
static const struct gpio_dt_spec motor_left_in2 =
	GPIO_DT_SPEC_GET(DT_ALIAS(motor_left_in2), gpios);
static const struct gpio_dt_spec motor_right_in3 =
	GPIO_DT_SPEC_GET(DT_ALIAS(motor_right_in3), gpios);
static const struct gpio_dt_spec motor_right_in4 =
	GPIO_DT_SPEC_GET(DT_ALIAS(motor_right_in4), gpios);

static const struct gpio_dt_spec *const direction_pins[] = {
	&motor_left_in1,
	&motor_left_in2,
	&motor_right_in3,
	&motor_right_in4,
};

static atomic_t manual_test_active = ATOMIC_INIT(0);

static int first_error(int previous, int candidate)
{
	return previous != 0 ? previous : candidate;
}

static int set_directions(const struct gpio_dt_spec *first,
			  const struct gpio_dt_spec *second, int first_value,
			  int second_value)
{
	int rc = gpio_pin_set_dt(first, first_value);

	return first_error(rc, gpio_pin_set_dt(second, second_value));
}

static int set_pwm_percent(const struct pwm_dt_spec *pwm, unsigned int duty_percent)
{
	if (duty_percent > 100U) {
		return -EINVAL;
	}

	return pwm_set_dt(pwm, pwm->period,
			  (pwm->period * duty_percent) / 100U);
}

int motor_control_safe_stop(void)
{
	int rc = 0;

	/* Disable the two L298N channels before changing either direction pair. */
	rc = first_error(rc, pwm_set_dt(&motor_left_pwm, motor_left_pwm.period, 0));
	rc = first_error(rc, pwm_set_dt(&motor_right_pwm, motor_right_pwm.period, 0));

	/* Both inputs low with enable low is a non-driving/coast state. */
	for (size_t i = 0; i < ARRAY_SIZE(direction_pins); ++i) {
		rc = first_error(rc, gpio_pin_set_dt(direction_pins[i], 0));
	}

	return rc;
}

int motor_control_set_state(enum motor_control_channel channel,
			    enum motor_control_state state, unsigned int duty_percent)
{
	const struct pwm_dt_spec *pwm;
	const struct gpio_dt_spec *first;
	const struct gpio_dt_spec *second;
	int forward_first;
	int forward_second;
	int rc;

	if (channel == MOTOR_CHANNEL_A) {
		pwm = &motor_left_pwm;
		first = &motor_left_in1;
		second = &motor_left_in2;
		/* Left wheel: OUT1/OUT2 polarity that moves the vehicle forward. */
		forward_first = 0;
		forward_second = 1;
	} else if (channel == MOTOR_CHANNEL_B) {
		pwm = &motor_right_pwm;
		first = &motor_right_in3;
		second = &motor_right_in4;
		/* Right wheel: OUT3/OUT4 polarity that moves the vehicle forward. */
		forward_first = 1;
		forward_second = 0;
	} else {
		return -EINVAL;
	}

	if (state != MOTOR_CONTROL_BRAKE && duty_percent > 100U) {
		return -EINVAL;
	}

	/* Never change H-bridge direction while its PWM enable is asserted. */
	rc = set_pwm_percent(pwm, 0U);
	if (rc != 0) {
		return rc;
	}

	switch (state) {
	case MOTOR_CONTROL_COAST:
		return set_directions(first, second, 0, 0);
	case MOTOR_CONTROL_FORWARD:
		rc = set_directions(first, second, forward_first, forward_second);
		break;
	case MOTOR_CONTROL_REVERSE:
		rc = set_directions(first, second, !forward_first, !forward_second);
		break;
	case MOTOR_CONTROL_BRAKE:
		/* L298N fast stop: short both motor terminals high while enabled. */
		rc = set_directions(first, second, 1, 1);
		duty_percent = 100U;
		break;
	default:
		return -EINVAL;
	}

	if (rc != 0) {
		return rc;
	}
	rc = set_pwm_percent(pwm, duty_percent);
	/* 10 us is visible on the scope; Lab 2's 100 us delayed channel B (and
	 * so DIR_A on IN4) by 100 us on every brake command. */
	testpoint_set(TP_PWM_SET, true);
	k_busy_wait(10);
	testpoint_set(TP_PWM_SET, false);
	return rc;
}

int motor_control_drive_forward(unsigned int duty_percent)
{
	int rc = motor_control_set_state(MOTOR_CHANNEL_A, MOTOR_CONTROL_FORWARD,
					 duty_percent);

	return first_error(rc, motor_control_set_state(MOTOR_CHANNEL_B,
						      MOTOR_CONTROL_FORWARD,
						      duty_percent));
}

int motor_control_dynamic_brake(void)
{
	int rc = motor_control_set_state(MOTOR_CHANNEL_A, MOTOR_CONTROL_BRAKE, 0U);

	return first_error(rc, motor_control_set_state(MOTOR_CHANNEL_B,
						      MOTOR_CONTROL_BRAKE, 0U));
}

int motor_control_init(void)
{
	int rc;

	if (!pwm_is_ready_dt(&motor_left_pwm) || !pwm_is_ready_dt(&motor_right_pwm)) {
		printk("Motor PWM device is not ready\n");
		return -ENODEV;
	}

	/* Keep both channels disabled while the direction pins are configured. */
	rc = set_pwm_percent(&motor_left_pwm, 0U);
	if (rc != 0) {
		return rc;
	}
	rc = set_pwm_percent(&motor_right_pwm, 0U);
	if (rc != 0) {
		return rc;
	}

	for (size_t i = 0; i < ARRAY_SIZE(direction_pins); ++i) {
		if (!gpio_is_ready_dt(direction_pins[i])) {
			printk("Motor direction GPIO is not ready\n");
			return -ENODEV;
		}

		rc = gpio_pin_configure_dt(direction_pins[i], GPIO_OUTPUT_ACTIVE);
		if (rc != 0) {
			return rc;
		}
	}

	/* Hold both wheels when the application starts without a Pi command. */
	rc = motor_control_dynamic_brake();
	if (rc == 0) {
		printk("Motor outputs initialized braked: PWM=100%%, IN1..IN4=1\n");
	}

	return rc;
}

bool motor_control_manual_test_active(void)
{
	return atomic_get(&manual_test_active) != 0;
}

int motor_control_pulse(enum motor_control_channel channel)
{
	int rc;

	if (channel != MOTOR_CHANNEL_A && channel != MOTOR_CHANNEL_B) {
		return -EINVAL;
	}

	/* A second shell request cannot overlap an active timed pulse. */
	if (!atomic_cas(&manual_test_active, 0, 1)) {
		return -EBUSY;
	}

	/* Begin from a known non-driving state before selecting a direction. */
	rc = motor_control_safe_stop();
	if (rc != 0) {
		goto done;
	}

	rc = motor_control_set_state(channel, MOTOR_CONTROL_FORWARD,
				     MOTOR_TEST_DUTY_PERCENT);
	if (rc == 0) {
		k_sleep(K_MSEC(MOTOR_TEST_DURATION_MS));
	}

	/* Restore the held-wheel idle state after the timed pulse. */
	rc = first_error(rc, motor_control_dynamic_brake());

done:
	atomic_set(&manual_test_active, 0);
	return rc;
}
```
